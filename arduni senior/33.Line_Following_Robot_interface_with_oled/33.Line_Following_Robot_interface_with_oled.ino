#include <Adafruit_GFX.h> 
#include <Adafruit_SSD1306.h> 
#define SCREEN_WIDTH 128 
#define SCREEN_HEIGHT 64  
#define OLED_RESET     -1 
Adafruit_SSD1306 display(SCREEN_WIDTH, SCREEN_HEIGHT, &Wire, OLED_RESET);
int buzzer = 3;
int right_sensor = 0;
int left_sensor = 0;
int middle_sensor = 0;
int turnSpeed = 150;
int Speed = 120;
const int mL1 = 13;
const int mL2 = 11;
const int mR1 = 10;
const int mR2 = 2;
const int enA = 5;
const int enB = 6;

int sense_value = 300;

const unsigned char smile_start [] PROGMEM = {
  0x00, 0x00, 0x00, 0x00, 0x00, 0x00, 0x00, 0x00, 0x00, 0x00, 0x00, 0x00, 0x00, 0x00, 0x00, 0x00, 
  0x00, 0x00, 0x00, 0x00, 0x00, 0x00, 0x00, 0x00, 0x00, 0x00, 0x00, 0x00, 0x00, 0x00, 0x00, 0x00, 
  0x00, 0x00, 0x00, 0x00, 0x00, 0x00, 0x00, 0x00, 0x00, 0x00, 0x00, 0x00, 0x00, 0x00, 0x00, 0x00, 
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  0x00, 0x00, 0x00, 0x00, 0x00, 0x00, 0x00, 0x00, 0x00, 0x00, 0x00, 0x00, 0x00, 0x00, 0x00, 0x00
};

const unsigned char smile_end [] PROGMEM = {
  0x00, 0x00, 0x00, 0x00, 0x00, 0x00, 0x00, 0x00, 0x00, 0x00, 0x00, 0x00, 0x00, 0x00, 0x00, 0x00, 
  0x00, 0x00, 0x00, 0x00, 0x00, 0x00, 0x00, 0x00, 0x00, 0x00, 0x00, 0x00, 0x00, 0x00, 0x00, 0x00, 
  0x00, 0x00, 0x00, 0x00, 0x00, 0x00, 0x00, 0x00, 0x00, 0x00, 0x00, 0x00, 0x00, 0x00, 0x00, 0x00, 
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  0x00, 0x00, 0x00, 0x00, 0x00, 0x00, 0x00, 0x00, 0x00, 0x00, 0x00, 0x00, 0x00, 0x00, 0x00, 0x00
};
void setup() {
  pinMode(mL1, OUTPUT);
  pinMode(mL2, OUTPUT);
  pinMode(mR1, OUTPUT);
  pinMode(mR2, OUTPUT);
  pinMode(enA, OUTPUT);
  pinMode(enB, OUTPUT);
  pinMode(buzzer,OUTPUT);
 Serial.begin(9600);
  display.begin(SSD1306_SWITCHCAPVCC, 0x3C);        
}void loop() {
  left_sensor = analogRead(A1);
    right_sensor = analogRead(A0);
    middle_sensor = analogRead(A3);
    Serial.print("right sensor = ");
    Serial.print(right_sensor);
    Serial.print(" ; ");
    Serial.print("left sensor = ");
    Serial.print(left_sensor);
    Serial.print(" ; ");
    Serial.print("middle sensor = ");
    Serial.print(middle_sensor);
    Serial.print(" ; ");
    Serial.print("\n");
    if ((middle_sensor <= sense_value) && (left_sensor >= sense_value) &&  (right_sensor >= sense_value)){
      forward();
     display.clearDisplay();
    display.drawBitmap(0, 0,smile_end, 128, 64, WHITE);
    display.display();
      for(int i = 0;i<20000;i++)
        {
        digitalWrite(buzzer,HIGH);
        }

        for(int j = 0;j<20000;j++)
        {
        digitalWrite(buzzer,LOW);
        }
        
    } else if ((middle_sensor >= sense_value) && (left_sensor <= sense_value) &&  (right_sensor >= sense_value)) {
      left();
    } else if ((middle_sensor >= sense_value) && (left_sensor >= sense_value) &&  (right_sensor <= sense_value)){
      right();
    } else if ((left_sensor <= sense_value) && (right_sensor <= sense_value) && (middle_sensor <=sense_value)) {
      stop_now();
    }else if ((middle_sensor <= sense_value) && (left_sensor <= sense_value) && (right_sensor >= sense_value)){
      left();
    }else if ((middle_sensor <= sense_value) && (right_sensor <= sense_value) && (left_sensor >= sense_value)){
      right();
    }else {
      
    stop_now();
    display.clearDisplay();
    display.drawBitmap(0, 0,  smile_start, 128, 64, WHITE);
    display.display();
}
}
void right() {
  digitalWrite(mL1,LOW);
digitalWrite(mL2,HIGH);
digitalWrite(mR1,HIGH);
digitalWrite(mR2,LOW);
analogWrite(enA, turnSpeed);
analogWrite(enB, turnSpeed);
}
void left() {
digitalWrite(mL1,HIGH);
digitalWrite(mL2,LOW);
digitalWrite(mR1,LOW);
digitalWrite(mR2,HIGH);
analogWrite(enA, turnSpeed);
analogWrite(enB, turnSpeed);
}

void stop_now() {
  digitalWrite(mL1, LOW);
  digitalWrite(mL2, LOW);
  digitalWrite(mR1, LOW);
  digitalWrite(mR2, LOW);
  analogWrite(enA, 0);
  analogWrite(enB, 0);
}

void forward() 
{
digitalWrite(mL1,HIGH);
digitalWrite(mL2,LOW);
digitalWrite(mR1,HIGH);
digitalWrite(mR2,LOW);
analogWrite(enA, Speed);
analogWrite(enB, Speed);
}
